## app/sample.yaml
```yaml
# This file is provided so that the application can be compiled using Twister,
# the Zephyr testing tool. In this file, multiple combinations can be specified,
# so that you can easily test all of them locally or in CI.
sample:
  description: BrailleNoteWindows nrf application
  name: BrailleNoteWindows
common:
  tags: introduction
  sysbuild: true
  integration_platforms:
    - ms50sfa_nrf52832
tests:
  app.default: {}
```

## boards/nordic/ms50sfa_nrf52832/Kconfig.ms50sfa_nrf52832
```kconfig
# Copyright (c) 2024 Nordic Semiconductor ASA
# SPDX-License-Identifier: Apache-2.0

config BOARD_MS50SFA_NRF52832
	select SOC_NRF52832_QFAA
```

## boards/nordic/ms50sfa_nrf52832/board.yml
```yaml
# Copyright (c) 2024 Nordic Semiconductor ASA
# SPDX-License-Identifier: Apache-2.0

board:
  name: ms50sfa_nrf52832
  vendor: nordic
  socs:
    - name: nrf52832
```
